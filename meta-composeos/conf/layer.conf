## meta-composeos/conf/layer.conf
```bitbake
# We have a conf and classes directory, add to BBPATH
BBPATH .= ":${LAYERDIR}"

# We have recipes-* directories, add to BBFILES
BBFILES += "${LAYERDIR}/recipes-*/*/*.bb \
            ${LAYERDIR}/recipes-*/*/*.bbappend"

BBFILE_COLLECTIONS += "composeos-layer"
BBFILE_PATTERN_composeos-layer = "^${LAYERDIR}/"
BBFILE_PRIORITY_composeos-layer = "10"

LAYERDEPENDS_composeos-layer = "core"
LAYERSERIES_COMPAT_composeos-layer = "langdale mickledore"

BBFILES_DYNAMIC += " \
  suxni:${LAYERDIR}/dynamic-layers/meta-sunxi/*/*.bbappend \
"
```
